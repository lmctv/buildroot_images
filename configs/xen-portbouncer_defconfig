## configs/xen-portbouncer_defconfig
```kconfig
BR2_x86_64=y
BR2_TOOLCHAIN_BUILDROOT_INET_IPV6=y
BR2_TARGET_GENERIC_HOSTNAME="portbouncer"
BR2_TARGET_GENERIC_ISSUE="Welcome to PortBouncer"
BR2_TARGET_GENERIC_ROOT_PASSWD_HASH="*"
BR2_ROOTFS_OVERLAY="$(BR2_EXTERNAL)/boards/uniroma2.it/xen-portbouncer/rootfs_overlay/"
BR2_ROOTFS_POST_BUILD_SCRIPT="$(BR2_EXTERNAL)/boards/uniroma2.it/xen-portbouncer/scripts/*"
BR2_PACKAGE_BUSYBOX_SHOW_OTHERS=y
BR2_PACKAGE_DBUS=y
BR2_PACKAGE_LIBCAP=y
BR2_PACKAGE_READLINE=y
BR2_PACKAGE_IPROUTE2=y
BR2_PACKAGE_IPTABLES=y
BR2_PACKAGE_KMOD=y
BR2_PACKAGE_KMOD_TOOLS=y
BR2_TARGET_ROOTFS_CPIO=y
BR2_TARGET_ROOTFS_CPIO_GZIP=y
BR2_TARGET_ROOTFS_TAR_GZIP=y
```
